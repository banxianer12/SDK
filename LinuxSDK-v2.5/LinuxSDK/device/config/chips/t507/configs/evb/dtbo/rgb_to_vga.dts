/dts-v1/;
/plugin/;

/ {

  compatible = "board_manufacturer,board_model";

  /* These properties are examples */
  board_id = <0x00000004>;
  board_rev = <0x00000000>;
  another_hw_information = "some_data";
  soc_id = <0x68000000>;

};

&soc {
	dtbo_version = <0x00000001>;
	dtbo{
		compatible = "allwinner,sunxi-dtbo";
		dtbo_type = <4>;
	};

	lcd0: lcd0@01c0c000 {
		lcd_used            = <1>;
		lcd_driver_name     = "default_lcd";
		lcd_backlight       = <100>;

		lcd_if              = <0>;
		lcd_hv_if           = <0>;

		lcd_x               = <1280>;
		lcd_y               = <800>;

		lcd_width           = <150>;
		lcd_height          = <94>;

		lcd_dclk_freq       = <76>;

		lcd_hbp             = <20>;
		lcd_ht              = <1418>;
		lcd_hspw            = <10>;
		lcd_vbp             = <10>;
		lcd_vt              = <814>;
		lcd_vspw            = <5>;

		lcd_pwm_used        = <1>;
		lcd_pwm_ch          = <0>;
		lcd_pwm_freq        = <50000>;
		lcd_pwm_pol         = <1>;
		lcd_pwm_max_limit   = <255>;

		lcd_frm             = <0>;
		lcd_gamma_en        = <0>;
		lcd_bright_curve_en = <0>;
		lcd_cmap_en         = <0>;

		deu_mode            = <0>;
		lcdgamma4iep        = <22>;
		smart_color         = <90>;

		lcd_pin_power = "bldo1";
		lcd_power = "dc1sw";
		lcd_bl_en        = <>;
		pinctrl-0 = <&rgb24_pins_a>;
		pinctrl-1 = <&rgb24_pins_b>;
	};
};
